/*********************************************************************************************************
* 模块名称：RCC.c
* 摘    要：RCC模块，包含各种时钟的配置
* 当前版本：1.0.0
* 作    者：SZLY(COPYRIGHT 2018 - 2020 SZLY. All rights reserved.)
* 完成日期：2020年01月01日 
* 内    容：
* 注    意：                                                                  
**********************************************************************************************************
* 取代版本：
* 作    者：
* 完成日期：
* 修改内容：
* 修改文件：
*********************************************************************************************************/

/*********************************************************************************************************
*                                              包含头文件
*********************************************************************************************************/
#include "RCC.h"
#include "stm32f4xx_conf.h"

/*********************************************************************************************************
*                                              宏定义
*********************************************************************************************************/

/*********************************************************************************************************
*                                              枚举结构体定义
*********************************************************************************************************/

/*********************************************************************************************************
*                                              内部变量
*********************************************************************************************************/

/*********************************************************************************************************
*                                              内部函数声明
*********************************************************************************************************/
static  void  ConfigRCC(void);  //配置RCC

/*********************************************************************************************************
*                                              内部函数实现
*********************************************************************************************************/
/*********************************************************************************************************
* 函数名称：ConfigRCC
* 函数功能：配置RCC 
* 输入参数：void
* 输出参数：void
* 返 回 值：void
* 创建日期：2018年01月01日
* 注    意：配置的时钟如下：
*           （0）外部晶振HSE          = 8MHz
*           （1）PLLCLK（PLL时钟）    = HSE/8*360/2 = 180MHz
*           （2）SYSCLK（系统时钟）   = PLLCLK = 180MHz
*           （3）HCLK（AHB总线时钟）  = SYSCLK = 180MHz
*           （4）PCLK1（APB1总线时钟）= HCLK/4 = 45MHz（APB1 timer clock=90MHz）
*           （5）PCLK2（APB2总线时钟）= HCLK/2 = 90MHz（APB2 timer clock=180MHz）
*           （6）Ethernet PTP clock   = 180MHz
*           （7）Memory and DMA clock = 180MHz
*           （8）Cortex system timer  = 180MHz
*           （9）FCLK Cortex clock    = 180MHz
*********************************************************************************************************/
static void ConfigRCC(void)
{
  __IO uint32_t HSEStartUpStatus = 0;  
  
  RCC_HSEConfig(RCC_HSE_ON);    //使能HSE（HSE=8MHz） 
  RCC_APB2PeriphClockCmd(RCC_APB2Periph_LTDC, ENABLE);
  RCC_AHB1PeriphClockCmd(RCC_AHB1Periph_DMA2D, ENABLE);
  
  HSEStartUpStatus = RCC_WaitForHSEStartUp();  //等待HSE启动

  if(SUCCESS == HSEStartUpStatus)  //如果HSE启动成功
  {
    RCC_APB1PeriphClockCmd(RCC_APB1Periph_PWR, ENABLE);  //使能电源接口时钟
    
    //将调压器输出电压级别配置为1，以便在器件未以最大频率工作时使性能与功耗实现平衡
    PWR_MainRegulatorModeConfig(PWR_Regulator_Voltage_Scale1);
    
    //配置HCLK、PCLK2和PCLK1
    RCC_HCLKConfig(RCC_SYSCLK_Div1); //HCLK=SYSCLK/1=180MHz    
    RCC_PCLK2Config(RCC_HCLK_Div2);  //PCLK2=HCLK/2=90MHz    
    RCC_PCLK1Config(RCC_HCLK_Div4);  //PCLK1=HCLK/4=45MHz
    
    //根据分频因子M、N、P、Q，配置PLL时钟，M=8，N=360，P=2，Q=4
    //VCO时钟频率=8MHz×(N/M)=360MHz，PLL时钟频率=360MHz/2=180MHz
    //USB OTG FS，SDIO，RNG时钟频率=360MHz/4=90MHz
    RCC_PLLConfig(RCC_PLLSource_HSE, 8, 360, 2, 4);    //PLLCLK=180MHz    
    
    RCC_PLLCmd(ENABLE);   //使能PLL
  
    //等待PLL稳定
    while(RCC_GetFlagStatus(RCC_FLAG_PLLRDY) == RESET)
    {
      
    }   
    
    //开启over-drive模式，以达到更高频率
    PWR_OverDriveCmd(ENABLE);
    while(PWR_GetFlagStatus(PWR_FLAG_ODRDY) == RESET)
    {
      
    }
    PWR_OverDriveSWCmd(ENABLE);
    while(PWR_GetFlagStatus(PWR_FLAG_ODSWRDY) == RESET)
    {
      
    }    
    
    //配置Flash，使能预取、指令缓存和数据缓存，并将延迟设置为5个等待周期
    FLASH_PrefetchBufferCmd(ENABLE);    
    FLASH_InstructionCacheCmd(ENABLE);
    FLASH_DataCacheCmd(ENABLE);    
    FLASH_SetLatency(FLASH_Latency_5);    
    
    RCC_SYSCLKConfig(RCC_SYSCLKSource_PLLCLK); //当PLL稳定之后，把PLL时钟切换为系统时钟SYSCLK

    //读取时钟切换状态位，确保PLLCLK被选为系统时钟
    while(RCC_GetSYSCLKSource() != 0x08)
    {
      
    }
  }
  else
  {
    //HSE启动出错，进入到死循环
    while(1)
    {
      
    }
  }
}

/*********************************************************************************************************
*                                              API函数实现
*********************************************************************************************************/
/*********************************************************************************************************
* 函数名称：InitRCC
* 函数功能：初始化RCC模块 
* 输入参数：void
* 输出参数：void
* 返 回 值：void
* 创建日期：2018年01月01日
* 注    意：
*********************************************************************************************************/
void InitRCC(void)
{
  ConfigRCC();  //配置RCC
}
